## led_toggler/build/Kconfig/arch/Kconfig
```kconfig
# Load Zephyr Arch Kconfig descriptions.
osource "/home/las/zephyrproject/zephyr/arch/rx/Kconfig"
osource "/home/las/zephyrproject/zephyr/arch/x86/Kconfig"
osource "/home/las/zephyrproject/zephyr/arch/xtensa/Kconfig"
osource "/home/las/zephyrproject/zephyr/arch/sparc/Kconfig"
osource "/home/las/zephyrproject/zephyr/arch/riscv/Kconfig"
osource "/home/las/zephyrproject/zephyr/arch/posix/Kconfig"
osource "/home/las/zephyrproject/zephyr/arch/mips/Kconfig"
osource "/home/las/zephyrproject/zephyr/arch/arm64/Kconfig"
osource "/home/las/zephyrproject/zephyr/arch/arm/Kconfig"
osource "/home/las/zephyrproject/zephyr/arch/arc/Kconfig"
```

## led_toggler/build/Kconfig/boards/Kconfig
```kconfig
# Load Zephyr board Kconfig descriptions.
osource "/home/las/zephyrproject/zephyr/boards/nxp/frdm_mcxn947/Kconfig"
```

## led_toggler/build/Kconfig/boards/Kconfig.defconfig
```kconfig
# Load Zephyr board defconfig descriptions.
osource "/home/las/zephyrproject/zephyr/boards/nxp/frdm_mcxn947/Kconfig.defconfig"
```

## led_toggler/build/Kconfig/boards/Kconfig.frdm_mcxn947
```kconfig
# Load board Kconfig descriptions.
osource "/home/las/zephyrproject/zephyr/boards/nxp/frdm_mcxn947/Kconfig.frdm_mcxn947"
```
